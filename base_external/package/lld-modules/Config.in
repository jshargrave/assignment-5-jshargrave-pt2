## base_external/package/lld-modules/Config.in
```kconfig
config BR2_PACKAGE_LLD_MODULES
	bool "lld modules"
	help
	  Includes the LLD modules with the misc-modules and scull components into the root filesystem.
```

## base_external/package/lld/Config.in
```kconfig
config BR2_PACKAGE_LLD
	bool "lld"
	help
	  Includes the LLD with the misc-modules and scull components into the root filesystem.
```
